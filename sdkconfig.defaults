## sdkconfig.defaults
```kconfig
CONFIG_CAMERA_SC2336=y
CONFIG_CAMERA_SC2336_AUTO_DETECT_MIPI_INTERFACE_SENSOR=y
CONFIG_CAMERA_SC2336_MIPI_RAW8_1280X720_30FPS=y
CONFIG_CAMERA_SC2336_MIPI_DEFAULT_FMT_RAW8_1280X720_30FPS=y
CONFIG_CAMERA_XCLK_USE_ESP_CLOCK_ROUTER=y
CONFIG_CAMERA_SENSOR_MOTOR_DETECT_METHOD_DYNAMIC_LINK=y

CONFIG_IDF_EXPERIMENTAL_FEATURES=y

CONFIG_ESP_VIDEO_ENABLE_ISP=y
CONFIG_ESP_VIDEO_ENABLE_DATA_PREPROCESSING=y
CONFIG_ESP_VIDEO_ENABLE_MIPI_CSI_VIDEO_DEVICE=y
CONFIG_ESP_VIDEO_ENABLE_DVP_VIDEO_DEVICE=y
CONFIG_ESP_VIDEO_ENABLE_ISP_VIDEO_DEVICE=y
CONFIG_ESP_VIDEO_ENABLE_SWAP_SHORT=y
CONFIG_ESP_VIDEO_ENABLE_SWAP_SHORT_RISCV=y
CONFIG_ESP_VIDEO_ENABLE_SWAP_BYTE=y
CONFIG_ESP_VIDEO_ENABLE_SWAP_BYTE_RISCV=y
CONFIG_ESP_VIDEO_CHECK_PARAMETERS=y
CONFIG_ESP_VIDEO_DISABLE_MIPI_CSI_DRIVER_BACKUP_BUFFER=y

CONFIG_EXAMPLE_VIDEO_BUFFER_TYPE_USER=y

CONFIG_I2C_SKIP_LEGACY_CONFLICT_CHECK=y

CONFIG_SPIRAM=y
CONFIG_SPIRAM_SPEED_200M=y

CONFIG_SLAVE_IDF_TARGET_ESP32C6=y
CONFIG_ESP_HOSTED_CP_TARGET_ESP32C6=y
CONFIG_ESP_HOSTED_P4_DEV_BOARD_FUNC_BOARD=y
CONFIG_WIFI_RMT_STATIC_RX_BUFFER_NUM=16
CONFIG_WIFI_RMT_DYNAMIC_RX_BUFFER_NUM=64
CONFIG_WIFI_RMT_DYNAMIC_TX_BUFFER_NUM=64
CONFIG_WIFI_RMT_AMPDU_TX_ENABLED=y
CONFIG_WIFI_RMT_TX_BA_WIN=32
CONFIG_WIFI_RMT_AMPDU_RX_ENABLED=y
CONFIG_WIFI_RMT_RX_BA_WIN=32
CONFIG_LWIP_TCP_SND_BUF_DEFAULT=65534
CONFIG_LWIP_TCP_WND_DEFAULT=65534
CONFIG_LWIP_TCP_RECVMBOX_SIZE=64
CONFIG_LWIP_UDP_RECVMBOX_SIZE=64
CONFIG_LWIP_TCPIP_RECVMBOX_SIZE=64
CONFIG_LWIP_TCP_SACK_OUT=y

CONFIG_PARTITION_TABLE_CUSTOM=y
CONFIG_PARTITION_TABLE_CUSTOM_FILENAME="partitions.csv"
CONFIG_PARTITION_TABLE_FILENAME="partitions.csv"
CONFIG_PARTITION_TABLE_OFFSET=0x8000
CONFIG_PARTITION_TABLE_MD5=y

CONFIG_ESPTOOLPY_FLASHMODE_DIO=y
CONFIG_ESPTOOLPY_FLASHFREQ_80M=y
CONFIG_ESPTOOLPY_FLASHSIZE_16MB=y
```

## 思路/camera_web_stream/sdkconfig.defaults
```kconfig
CONFIG_ESP_WIFI_REMOTE_ENABLED=y
CONFIG_ESP_WIFI_REMOTE_IDF_SPECIFIC_ADDED=y
CONFIG_ESP_WIFI_REMOTE_LIBRARY_HOSTED=y
CONFIG_ESP_WIFI_REMOTE_EAP_ENABLED=y
CONFIG_WIFI_RMT_STATIC_RX_BUFFER_NUM=16
CONFIG_WIFI_RMT_DYNAMIC_RX_BUFFER_NUM=64
CONFIG_WIFI_RMT_DYNAMIC_TX_BUFFER=y
CONFIG_WIFI_RMT_TX_BUFFER_TYPE=1
CONFIG_WIFI_RMT_DYNAMIC_TX_BUFFER_NUM=64
CONFIG_WIFI_RMT_STATIC_RX_MGMT_BUFFER=y
CONFIG_WIFI_RMT_DYNAMIC_RX_MGMT_BUF=0
CONFIG_WIFI_RMT_RX_MGMT_BUF_NUM_DEF=5
CONFIG_WIFI_RMT_AMPDU_TX_ENABLED=y
CONFIG_WIFI_RMT_TX_BA_WIN=32
CONFIG_WIFI_RMT_AMPDU_RX_ENABLED=y
CONFIG_WIFI_RMT_RX_BA_WIN=32
CONFIG_WIFI_RMT_NVS_ENABLED=y
CONFIG_WIFI_RMT_SOFTAP_BEACON_MAX_LEN=752
CONFIG_WIFI_RMT_MGMT_SBUF_NUM=32
CONFIG_WIFI_RMT_IRAM_OPT=y
CONFIG_WIFI_RMT_EXTRA_IRAM_OPT=y
CONFIG_WIFI_RMT_RX_IRAM_OPT=y
CONFIG_WIFI_RMT_ENABLE_WPA3_SAE=y
CONFIG_WIFI_RMT_ENABLE_SAE_H2E=y
CONFIG_WIFI_RMT_ENABLE_SAE_PK=y
CONFIG_WIFI_RMT_SOFTAP_SAE_SUPPORT=y
CONFIG_WIFI_RMT_ENABLE_WPA3_OWE_STA=y
CONFIG_WIFI_RMT_WPA3_COMPATIBLE_SUPPORT=y
CONFIG_WIFI_RMT_SLP_IRAM_OPT=y
CONFIG_WIFI_RMT_SLP_DEFAULT_MIN_ACTIVE_TIME=50
CONFIG_WIFI_RMT_BSS_MAX_IDLE_SUPPORT=y
CONFIG_WIFI_RMT_SLP_DEFAULT_MAX_ACTIVE_TIME=10
CONFIG_WIFI_RMT_SLP_DEFAULT_WAIT_BROADCAST_DATA_TIME=15
CONFIG_WIFI_RMT_STA_DISCONNECTED_PM_ENABLE=y
CONFIG_WIFI_RMT_GMAC_SUPPORT=y
CONFIG_WIFI_RMT_SOFTAP_SUPPORT=y
CONFIG_WIFI_RMT_ESPNOW_MAX_ENCRYPT_NUM=7
CONFIG_WIFI_RMT_MBEDTLS_CRYPTO=y
CONFIG_WIFI_RMT_MBEDTLS_TLS_CLIENT=y
CONFIG_WIFI_RMT_TX_HETB_QUEUE_NUM=3
CONFIG_WIFI_RMT_ENTERPRISE_SUPPORT=y
```
